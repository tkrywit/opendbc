VERSION ""

NS_ :

BS_:

BU_: XXX

BO_ 380 ENGINE: 8 XXX
 SG_ NEW_SIGNAL_2 : 61|2@0+ (1,0) [0|3] "" XXX
 SG_ ENGINE_RPM : 23|16@0+ (1,0) [0|255] "" XXX

BO_ 777 WHEEL_SPEEDS: 8 XXX
 SG_ LEFT_WHEEL_SPEED : 23|8@0+ (1,0) [0|255] "" XXX
 SG_ RIGHT_WHEEL_SPEED : 31|8@0+ (1,0) [0|255] "" XXX
